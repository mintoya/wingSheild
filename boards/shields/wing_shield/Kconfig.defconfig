## boards/shields/wing_shield/Kconfig.defconfig
```kconfig
if SHIELD_WING_LEFT

config ZMK_KEYBOARD_NAME
    default "Wing_left"

config ZMK_SPLIT_ROLE_CENTRAL
    default y

config ZMK_STUDIO
    default y

endif
```

## boards/shields/wing_shield/Kconfig.shield
```kconfig
config WING_LEFT
    def_bool $(shields_list_contains,wing_left)

config WING_RIGHT
    def_bool $(shields_list_contains,wing_right)
```
